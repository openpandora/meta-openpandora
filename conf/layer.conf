## conf/layer.conf
```bitbake
# We have a conf and classes directory, append to BBPATH
BBPATH .= ":${LAYERDIR}"

# We have a recipes directory containing .bb and .bbappend files, add to BBFILES
BBFILES := "${BBFILES} ${LAYERDIR}/recipes*/*/*.bb \ 
            ${LAYERDIR}/recipes*/*/*.bbappend"

BBFILE_COLLECTIONS += "openpandora"
BBFILE_PATTERN_openpandora := "^${LAYERDIR}/"
BBFILE_PRIORITY_openpandora = "6"
```

## conf/machine/include/omap3.inc
```bitbake
SOC_FAMILY = "omap3"

require conf/machine/include/tune-cortexa8.inc

KERNEL_IMAGETYPE = "uImage"

UBOOT_ENTRYPOINT = "0x80008000"
UBOOT_LOADADDRESS = "0x80008000"

EXTRA_IMAGEDEPENDS += "u-boot x-load"
```

## conf/machine/omap3-pandora.conf
```bitbake
#@TYPE: Machine
#@NAME: OMAP3 based Pandora Handheld Console
#@DESCRIPTION: Machine configuration for the Pandora http://www.openpandora.org/ Handheld Console
#@MAINTAINER: John Willis

TARGET_ARCH = "arm"

PREFERRED_PROVIDER_virtual/bootloader = "u-boot-omap3pandora"

#800 * 480 Widescreen
GUI_MACHINE_CLASS = "bigscreen"
MACHINE_DISPLAY_WIDTH_PIXELS = "800"
MACHINE_DISPLAY_HEIGHT_PIXELS = "480"

IMAGE_FSTYPES += "tar.bz2 ubi"
#IMAGE_FSTYPES = "tar.bz2"

SERIAL_CONSOLE = "115200 ttyS0"

require conf/machine/include/omap3.inc

# Put it below omap3.inc as we override the kernel and PR here
PREFERRED_PROVIDER_virtual/kernel = "linux-${MACHINE}"
MACHINE_KERNEL_PR = "r4"

PREFERRED_PROVIDER_virtual/xserver = "xserver-xorg"

XSERVER = " \
	xserver-xorg \
	xf86-input-evdev \
	xf86-input-mouse \
	xf86-input-keyboard \
	xf86-input-tslib \
	xf86-video-fbdev \
	xf86-video-omapfb \
"

KERNEL_IMAGETYPE = "uImage"

# do ubiattach /dev/ubi_ctrl -m 4
# From dmesg:
# UBI: smallest flash I/O unit:    2048
# UBI: logical eraseblock size:    129024 bytes
# from ubiattach stdout:
# UBI device number 0, total 1996 LEBs
MKUBIFS_ARGS = "-m 2048 -e 129024 -c 1996"

# do ubiattach /dev/ubi_ctrl -m 4
# from dmesg:
# UBI: smallest flash I/O unit:    2048
# UBI: physical eraseblock size:   131072 bytes (128 KiB)
# UBI: sub-page size:              512
UBINIZE_ARGS = "-m 2048 -p 128KiB -s 512"

UBOOT_ENTRYPOINT = "0x80008000"
UBOOT_LOADADDRESS = "0x80008000"
UBOOT_ARCH = "arm"
UBOOT_MACHINE = "omap3_pandora_config"

PREFERRED_PROVIDER_x-load = "x-load-omap3pandora"
EXTRA_IMAGEDEPENDS += "virtual/bootloader x-load"

MACHINE_FEATURES = "kernel26 apm usbgadget usbhost keyboard vfat ext2 screen touchscreen alsa bluetooth wifi sdio"

# OpenGLES recipes need meta-texasinstruments as a layer.

PREFERRED_VERSION_omap3-sgx-modules = "1.6.16.3977"

OPENGLES = " \
  omap3-sgx-modules devmem2 \
  libgles-omap3 \
"

MACHINE_EXTRA_RRECOMMENDS += " \
	openpandora-firmware \
	wl1251-init \
	${OPENGLES} \
"
```

## conf/machine/openpandora.conf
```bitbake
#@TYPE: Machine
#@NAME: OMAP3 based Pandora Handheld Console
#@DESCRIPTION: Machine configuration for the Pandora http://www.openpandora.org/ Handheld Console
#@MAINTAINER: John Willis

require conf/machine/include/omap3.inc

PREFERRED_PROVIDER_virtual/xserver = "xserver-xorg"
XSERVER = "xserver-xorg \
           xf86-input-evdev \
           xf86-input-mouse \
           xf86-video-omapfb \
           xf86-input-keyboard"



MACHINE_FEATURES = "kernel26 apm usbgadget usbhost keyboard vfat ext2 screen touchscreen alsa bluetooth wifi sdio"

PREFERRED_PROVIDER_virtual/kernel = "linux-omap3-pandora"
MACHINE_EXTRA_RRECOMMENDS = "kernel-modules openpandora-firmware openpandora-u-boot-autoboot-sd"

PREFERRED_PROVIDER_x-load = "x-load-openpandora"
PREFERRED_VERSION_libgles-omap3 = "4.00.00.01"
PREFERRED_VERSION_omap3-sgx-modules = "4.00.00.01"
```
